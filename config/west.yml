## config/west.yml
```yaml
manifest:
  remotes:
    - name: zmkfirmware
      url-base: https://github.com/zmkfirmware
    - name: DoctorWangWang
      url-base: https://github.com/DoctorWangWang
    - name: inorichi
      url-base: https://github.com/inorichi
  projects:
    - name: zmk
      remote: DoctorWangWang
      revision: feat/pointers-move-scroll
      import: app/west.yml
    - name: zmk-pmw3610-driver
      remote: inorichi
      revision: main
 - name: zmk
      remote: zmkfirmware
      revision: main
      # remote: zephyr-3
      # revision: zephyr/3.1-upgrade
      # remote: kuolemax
      # revision: encoder-fix
      import: app/west.yml
  self:
    path: config
```
